## br2-external-temp-controller/Config.in
```kconfig
source "$BR2_EXTERNAL_TEMP_CONTROLLER_PATH/package/temperature-controller/Config.in"
```

## br2-external-temp-controller/package/temperature-controller/Config.in
```kconfig
config BR2_PACKAGE_TEMPERATURE_CONTROLLER
    bool "temperature-controller"
    select BR2_PACKAGE_I2C_TOOLS
    help
        Heats, measures, and maintains the temperature of a temperature sensor.
```
